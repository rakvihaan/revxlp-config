## config/boards/shields/preonic_rak/Kconfig.defconfig
```kconfig
# Copyright (c) 2020 The ZMK Contributors
# SPDX-License-Identifier: MIT

if SHIELD_PREONIC_RAK

config ZMK_KEYBOARD_NAME
    default "preonic_rak"

if ZMK_BACKLIGHT

config LED_GPIO
    default y

endif # ZMK_BACKLIGHT

endif
```

## config/boards/shields/preonic_rak/Kconfig.shield
```kconfig
# Copyright (c) 2020 The ZMK Contributors
# SPDX-License-Identifier: MIT

config SHIELD_PREONIC_RAK
    def_bool $(shields_list_contains,preonic_rak)
    select SPI
```
